## ESP32_IDF_Clock/components/devunit/Kconfig
```kconfig
menu "My DevBoard hardware config"
    config SOFTWARE_INTERNAL_WIFI_SUPPORT
        bool "WIFI-Hardware"
        default y
endmenu

menu "My DevBoard software config"

    config ESP_WIFI_SSID
        string "WiFi SSID"
        default "myssid"
        help
            SSID (network name) for the example to connect to.

    config ESP_WIFI_PASSWORD
        string "WiFi Password"
        default "mypassword"
        help
            WiFi password (WPA or WPA2 or WPA3) for the example to use.

    choice ESP_WIFI_SAE_MODE
        prompt "WPA3 SAE mode selection"
        default ESP_WPA3_SAE_PWE_BOTH
        help
            Select mode for SAE as Hunt and Peck, H2E or both.
        config ESP_WPA3_SAE_PWE_HUNT_AND_PECK
            bool "HUNT AND PECK"
        config ESP_WPA3_SAE_PWE_HASH_TO_ELEMENT
            bool "H2E"
        config ESP_WPA3_SAE_PWE_BOTH
            bool "BOTH"
    endchoice

    config ESP_WIFI_PW_ID
        string "PASSWORD IDENTIFIER"
        depends on  ESP_WPA3_SAE_PWE_HASH_TO_ELEMENT|| ESP_WPA3_SAE_PWE_BOTH
        default ""
        help
            password identifier for SAE H2E

    config ESP_WIFI_MAXIMUM_RETRY
        int "Maximum retry"
        default 5
        help
            Set the Maximum retry to avoid station reconnecting to the AP unlimited when the AP is really inexistent.

    choice ESP_WIFI_SCAN_AUTH_MODE_THRESHOLD
        prompt "WiFi Scan auth mode threshold"
        default ESP_WIFI_AUTH_WPA2_WPA3_PSK
        help
            The weakest authmode to accept in the scan mode.
            This value defaults to ESP_WIFI_AUTH_WPA2_PSK incase password is present and ESP_WIFI_AUTH_OPEN is used.
            Please select ESP_WIFI_AUTH_WEP/ESP_WIFI_AUTH_WPA_PSK incase AP is operating in WEP/WPA mode.

        config ESP_WIFI_AUTH_OPEN
            bool "OPEN"
        config ESP_WIFI_AUTH_WEP
            bool "WEP"
        config ESP_WIFI_AUTH_WPA_PSK
            bool "WPA PSK"
        config ESP_WIFI_AUTH_WPA2_PSK
            bool "WPA2 PSK"
        config ESP_WIFI_AUTH_WPA_WPA2_PSK
            bool "WPA/WPA2 PSK"
        config ESP_WIFI_AUTH_WPA3_PSK
            bool "WPA3 PSK"
        config ESP_WIFI_AUTH_WPA2_WPA3_PSK
            bool "WPA2/WPA3 PSK"
        config ESP_WIFI_AUTH_WAPI_PSK
            bool "WAPI PSK"
    endchoice

    config NTP_SERVER_NAME
        string "Ntp Server Name"
        default "XXX.XXX.XXX.XXX"

endmenu

menu "My DevUnit config"
    config SOFTWARE_EXTERNAL_RTC_SUPPORT
        bool "RTC(PCF8563)-Hardware [External]"
        select SOFTWARE_EXTERNAL_I2C_SUPPORT
        default y
    config SOFTWARE_EXTERNAL_RTC_CLOCKOUT_1KHZ_SUPPORT
        bool "RTC(PCF8563) CLOCKOUT_1KHZ"
        depends on SOFTWARE_EXTERNAL_RTC_SUPPORT
        default y
    config SOFTWARE_EXTERNAL_I2C_SUPPORT
        bool "I2C-Hardware [External]"
        default y
    config SOFTWARE_EXTERNAL_6DIGIT_DISPLAY_SUPPORT
        bool "6DIGIT Display-Hardware [External]"
        default n
    config SOFTWARE_EXTERNAL_4DIGIT_DISPLAY_SUPPORT
        bool "4DIGIT(colon) Display-Hardware [External]"
        default n
    config SOFTWARE_EXTERNAL_DIGIT_DISPLAY_SUPPORT
        bool "DIGIT Display-Hardware [External]"
        depends on SOFTWARE_EXTERNAL_6DIGIT_DISPLAY_SUPPORT || SOFTWARE_EXTERNAL_4DIGIT_DISPLAY_SUPPORT
        default y
    config SOFTWARE_EXTERNAL_HT16K33_SUPPORT
        bool "HT16K33-Hardware [External]"
        select SOFTWARE_EXTERNAL_I2C_SUPPORT
        default n
    config SOFTWARE_SENSOR_SHT4X_SUPPORT
        bool "SENSOR SHT4X-Hardware [External]"
        select SOFTWARE_EXTERNAL_I2C_SUPPORT
        default n

endmenu
```
